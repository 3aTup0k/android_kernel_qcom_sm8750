// SPDX-License-Identifier: BSD-3-Clause
/*
 * Copyright (c) 2023-2024 Qualcomm Innovation Center, Inc. All rights reserved.
 * Copyright (c) 2025 The LineageOS Project
 */

dsi_sim_vid_esync: qcom,mdss_dsi_sim_video_esync {
	qcom,mdss-dsi-qsync-min-refresh-rate = <0x3c>;
	qcom,dsi-qsync-avr-step-fps = <0xf0>;
	qcom,video-psr-enable;
	qcom,vrr-enable;
	qcom,qsync-enable;
	qcom,mdss-esync-emsync-milli-pulse-width = <0xc8>;
	qcom,mdss-esync-emsync-fps = <0xf0>;
	qcom,mdss-esync-hsync-milli-pulse-width = <0x1f4>;
	qcom,mdss-esync;
	qcom,dsi-select-clocks = "pll_byte_clk0", "pll_dsi_clk0";
	qcom,panel-ack-disabled;
	qcom,mdss-dsi-reset-sequence = <0x01 0x00 0x00 0x00 0x01 0x00>;
	qcom,mdss-dsi-mdp-trigger = "none";
	qcom,mdss-dsi-dma-trigger = "trigger_sw";
	qcom,mdss-dsi-t-clk-pre = <0x1b>;
	qcom,mdss-dsi-t-clk-post = <0x04>;
	qcom,mdss-dsi-lane-3-state;
	qcom,mdss-dsi-lane-2-state;
	qcom,mdss-dsi-lane-1-state;
	qcom,mdss-dsi-lane-0-state;
	qcom,mdss-dsi-bllp-power-mode;
	qcom,mdss-dsi-bllp-eof-power-mode;
	qcom,mdss-dsi-traffic-mode = "non_burst_sync_event";
	qcom,mdss-dsi-panel-blackness-level = <0xc9e>;
	qcom,mdss-dsi-panel-peak-brightness = <0x401640>;
	qcom,mdss-dsi-panel-hdr-color-primaries = <0x38a4 0x3c8c 0x7d00 0x4268 0x3c8c 0x7530 0x1f40 0xbb8>;
	qcom,mdss-dsi-panel-hdr-enabled;
	qcom,mdss-dsi-border-color = <0x00>;
	qcom,mdss-dsi-underflow-color = <0xff>;
	qcom,mdss-dsi-bpp = <0x18>;
	qcom,mdss-dsi-stream = <0x00>;
	qcom,mdss-dsi-virtual-channel-id = <0x00>;
	qcom,dsi-phy-num = <0x00>;
	qcom,dsi-ctrl-num = <0x00>;
	qcom,mdss-dsi-panel-type = "dsi_video_mode";
	qcom,mdss-dsi-panel-name = "Simulator video mode dsi panel with esync";

	qcom,mdss-dsi-display-timings {

		timing@0 {
			qcom,default-topology-index = <0x00>;
			qcom,display-topology = <0x02 0x02 0x01>;
			qcom,mdss-dsi-panel-phy-timings = [00 2d 0c 0c 1d 27 0c 0d 0b 02 04 00 25 11];
			qcom,mdss-dsc-block-prediction-enable;
			qcom,mdss-dsc-bit-per-pixel = <0x08>;
			qcom,mdss-dsc-bit-per-component = <0x08>;
			qcom,mdss-dsc-slice-per-pkt = <0x01>;
			qcom,mdss-dsc-slice-width = <0x2d0>;
			qcom,mdss-dsc-slice-height = <0x28>;
			qcom,compression-mode = "dsc";
			qcom,mdss-dsi-off-command-state = "dsi_lp_mode";
			qcom,mdss-dsi-on-command-state = "dsi_lp_mode";
			qcom,mdss-dsi-off-command = [22 01 00 00 00 00 02 00 00];
			qcom,mdss-dsi-freq-step-pattern2-command = [39 01 00 00 00 00 02 00 00];
			qcom,mdss-dsi-freq-step-pattern1-command = [39 01 00 00 00 00 02 00 00];
			qcom,mdss-dsi-qsync-freq-step-sequence = <0xea60 0x01 0x2710 0x01 0x2710 0x02>;
			qcom,mdss-dsi-qsync-freq-step-sequence-interval = <0x00 0x1d4c0 0x02 0x00 0x2710 0x01>;
			qcom,mdss-dsi-sticky_on_fly-command = <0x5010000 0x100>;
			qcom,mdss-dsi-sticky_still_disable-command = <0x5010000 0x100>;
			qcom,mdss-dsi-sticky_still_en-command = <0x5010000 0x100>;
			qcom,mdss-dsi-esync-post-on-commands = [32 01 00 00 00 00 02 00 00];
			qcom,mdss-dsi-on-command = [32 01 00 00 00 00 02 00 00];
			qcom,mdss-dsi-panel-framerate = <0x78>;
			qcom,mdss-dsi-v-bottom-border = <0x00>;
			qcom,mdss-dsi-v-top-border = <0x00>;
			qcom,mdss-dsi-h-right-border = <0x00>;
			qcom,mdss-dsi-h-left-border = <0x00>;
			qcom,mdss-dsi-v-pulse-width = <0x02>;
			qcom,mdss-dsi-v-front-porch = <0x06>;
			qcom,mdss-dsi-v-back-porch = <0x06>;
			qcom,mdss-dsi-h-sync-skew = <0x00>;
			qcom,mdss-dsi-h-pulse-width = <0x08>;
			qcom,mdss-dsi-h-back-porch = <0x08>;
			qcom,mdss-dsi-h-front-porch = <0x08>;
			qcom,mdss-dsi-panel-height = <0xa00>;
			qcom,mdss-dsi-panel-width = <0x5a0>;
		};
	};
};
