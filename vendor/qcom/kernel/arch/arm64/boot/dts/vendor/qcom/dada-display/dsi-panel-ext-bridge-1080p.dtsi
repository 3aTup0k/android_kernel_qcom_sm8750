// SPDX-License-Identifier: BSD-3-Clause
/*
 * Copyright (c) 2023-2024 Qualcomm Innovation Center, Inc. All rights reserved.
 * Copyright (c) 2025 The LineageOS Project
 */

dsi_ext_bridge_1080p: qcom,mdss_dsi_ext_bridge_1080p {
	qcom,mdss-dsi-ext-bridge-mode;
	qcom,mdss-dsi-force-clock-lane-hs;
	qcom,mdss-dsi-t-clk-pre = <0x24>;
	qcom,mdss-dsi-t-clk-post = <0x03>;
	qcom,mdss-dsi-mdp-trigger = "none";
	qcom,mdss-dsi-dma-trigger = "trigger_sw";
	qcom,mdss-dsi-lane-3-state;
	qcom,mdss-dsi-lane-2-state;
	qcom,mdss-dsi-lane-1-state;
	qcom,mdss-dsi-lane-0-state;
	qcom,mdss-dsi-bllp-power-mode;
	qcom,mdss-dsi-bllp-eof-power-mode;
	qcom,mdss-dsi-traffic-mode = "non_burst_sync_pulse";
	qcom,mdss-dsi-border-color = <0x00>;
	qcom,mdss-dsi-bpp = <0x18>;
	qcom,mdss-dsi-stream = <0x00>;
	qcom,mdss-dsi-virtual-channel-id = <0x00>;
	qcom,dsi-select-clocks = "pll_byte_clk0", "pll_dsi_clk0";
	qcom,dsi-phy-num = <0x00>;
	qcom,dsi-ctrl-num = <0x00>;
	qcom,mdss-dsi-panel-type = "dsi_video_mode";
	qcom,mdss-dsi-panel-name = "ext video mode dsi bridge";

	qcom,mdss-dsi-display-timings {

		timing@0 {
			qcom,mdss-dsi-panel-phy-timings = [00 1e 08 07 18 22 08 08 08 02 04 1a 0c 00];
			qcom,default-topology-index = <0x00>;
			qcom,display-topology = <0x01 0x00 0x01>;
			qcom,mdss-dsi-panel-framerate = <0x3c>;
			qcom,mdss-dsi-h-sync-pulse = <0x00>;
			qcom,mdss-dsi-v-pulse-width = <0x05>;
			qcom,mdss-dsi-v-front-porch = <0x04>;
			qcom,mdss-dsi-v-back-porch = <0x24>;
			qcom,mdss-dsi-h-sync-skew = <0x00>;
			qcom,mdss-dsi-h-pulse-width = <0x2c>;
			qcom,mdss-dsi-h-back-porch = <0x94>;
			qcom,mdss-dsi-h-front-porch = <0x58>;
			qcom,mdss-dsi-panel-height = <0x438>;
			qcom,mdss-dsi-panel-width = <0x780>;
		};
	};
};
