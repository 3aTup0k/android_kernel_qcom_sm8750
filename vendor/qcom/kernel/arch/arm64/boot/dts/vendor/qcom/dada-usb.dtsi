// SPDX-License-Identifier: BSD-3-Clause
/*
 * Copyright (c) 2023-2024 Qualcomm Innovation Center, Inc. All rights reserved.
 * Copyright (c) 2025 The LineageOS Project
 */

&usb0 {
	qcom,wcd_usbss = <&wcd_usbss>;
	wcd_equ = <0xc0>;
	wcd_equ_host = <0xc0>;
	maximum_speed = "super-speed";
	host-force-gen1;
};

&usb_qmp_dp_phy {
	usb3,eyegram-tuning;
	qcom,usb3-phy-eye-seq = <0x1f38 0x1f 0x1f6c 0x17>;
	qcom,host-usb3-phy-eye-seq = <0x1f38 0x1f 0x1f6c 0x17>;
};
