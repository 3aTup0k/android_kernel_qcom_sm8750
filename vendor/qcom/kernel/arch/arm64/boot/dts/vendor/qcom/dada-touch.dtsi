// SPDX-License-Identifier: BSD-3-Clause
/*
 * Copyright (c) 2023-2024 Qualcomm Innovation Center, Inc. All rights reserved.
 * Copyright (c) 2025 The LineageOS Project
 */

&qupv3_se2_spi {
	status = "ok";
	pinctrl-0 = <&mi_ts_spi_mosi_active &mi_ts_spi_miso_active &mi_ts_spi_clk_active &mi_ts_spi_cs_active>;
	pinctrl-1 = <&mi_ts_spi_sleep &mi_ts_spi_cs_sleep>;
	qcom,la-vm;
	qcom,rt;

	synaptics_tcm@0 {
		compatible = "synaptics,tcm-spi";
		reg = <0x00>;
		spi-max-frequency = <15000000>;
		interrupt-parent = <&tlmm>;
		interrupts = <0xa2 0x2008>;
		synaptics,avdd-name = "avdd";
		avdd-supply = <&L16B>;
		synaptics,iovdd-name = "iovdd";
		iovdd-supply = <&L12B>;
		synaptics,irq-gpio = <&tlmm 0xa2 0x2008>;
		synaptics,reset-gpio = <&tlmm 0xa1 0x00>;
		synaptics,irq-on-state = <0x00>;
		synaptics,spi-mode = <0x00>;
		synaptics,byte-delay-us = <0>;
		synaptics,block-delay-us = <0>;
		synaptics,power-delay-ms = <50>;
		synaptics,reset-active-ms = <10>;
		synaptics,reset-delay-ms = <200>;
		synaptics,ubl-max-freq = <0xe4e1c0>;
		synaptics,ubl-byte-delay-us = <20>;
		synaptics,fod-lx = <0x1f4>;
		synaptics,fod-ly = <0x790>;
		synaptics,fod-x-size = <0xc7>;
		synaptics,fod-y-size = <0xc7>;
		synaptics,max-x = <0x4b0>;
		synaptics,max-y = <0xa6e>;
		synaptics,rx-num = <0x11>;
		synaptics,tx-num = <0x26>;
		synaptics,special-rx-num = <0x11>;
		synaptics,special-tx-num = <0x26>;
		synaptics,frame-data-page-size = <0x01>;
		synaptics,frame-data-buf-size = <0x0a>;
		synaptics,raw-data-page-size = <0x05>;
		synaptics,raw-data-buf-size = <0x05>;
		pinctrl-names = "pmx_ts_active", "pmx_ts_suspend";
		pinctrl-0 = <&syna_tcm_eint_init &syna_tcm_rst_init>;
		pinctrl-1 = <&syna_tcm_eint_suspend &syna_tcm_rst_suspend>;
		synaptics,super-resolution-factor = <0x64>;
		mi_tp,game-mode-array = <0x01 0x00 0x00 0x00 0x00>;
		mi_tp,active-mode-array = <0x01 0x00 0x00 0x00 0x00>;
		mi_tp,tolerance-array = <0x04 0x00 0x02 0x02 0x02>;
		mi_tp,up-threshold-array = <0x04 0x00 0x03 0x03 0x03>;
		mi_tp,aim-sensitivity-array = <0x04 0x00 0x02 0x02 0x02>;
		mi_tp,tap-stability-array = <0x04 0x00 0x02 0x02 0x02>;
		mi_tp,edge-filter-array = <0x03 0x00 0x02 0x02 0x02>;
		mi_tp,panel-orien-array = <0x03 0x00 0x00 0x00 0x00>;
		mi_tp,report-rate-array = <0x03 0x00 0x00 0x00 0x00>;
		mi_tp,expert-mode-array = <0x03 0x01 0x01 0x01 0x01>;
		mi_tp,cornerfilter-area-step-array = <0x00 0x64 0xaa 0xfa>;
		mi_tp,cornerzone-filter-hor1-array = <0x00 0x00 0x00 0x00 0xaa 0xaa 0x00 0x00 0x00 0x01 0x00 0x00 0x00 0x00 0x00 0x00 0x00 0x02 0x00 0x8b5 0xaa 0x95f 0x00 0x00 0x00 0x03 0x00 0x00 0x00 0x00 0x00 0x00>;
		mi_tp,cornerzone-filter-hor2-array = <0x00 0x00 0x00 0x00 0x00 0x00 0x00 0x00 0x00 0x01 0x38d 0x00 0x437 0xaa 0x00 0x00 0x00 0x02 0x00 0x00 0x00 0x00 0x00 0x00 0x00 0x03 0x38d 0x8b5 0x437 0x95f 0x00 0x00>;
		mi_tp,cornerzone-filter-ver-array = <0x00 0x00 0x00 0x00 0x00 0x00 0x00 0x00 0x00 0x01 0x00 0x00 0x00 0x00 0x00 0x00 0x00 0x02 0x00 0x833 0x96 0x95f 0x00 0x00 0x00 0x03 0x3a1 0x833 0x437 0x95f 0x00 0x00>;
		mi_tp,deadzone-filter-hor-array = <0x02 0x00 0x00 0x00 0x437 0x05 0x00 0x00 0x02 0x01 0x00 0x95a 0x437 0x95f 0x00 0x00 0x02 0x02 0x00 0x00 0x00 0x00 0x00 0x00 0x02 0x03 0x00 0x00 0x00 0x00 0x00 0x00>;
		mi_tp,deadzone-filter-ver-array = <0x02 0x00 0x00 0x00 0x00 0x00 0x00 0x00 0x02 0x01 0x00 0x00 0x00 0x00 0x00 0x00 0x02 0x02 0x00 0x00 0x05 0x95f 0x00 0x00 0x02 0x03 0x432 0x00 0x437 0x95f 0x00 0x00>;
		mi_tp,edgezone-filter-hor-array = <0x01 0x00 0x00 0x00 0x437 0x28 0x00 0x00 0x01 0x01 0x00 0x937 0x437 0x95f 0x00 0x00 0x01 0x02 0x00 0x00 0x28 0x95f 0x00 0x00 0x01 0x03 0x40f 0x00 0x437 0x95f 0x00 0x00>;
		mi_tp,edgezone-filter-ver-array = <0x01 0x00 0x00 0x00 0x00 0x00 0x00 0x00 0x01 0x01 0x00 0x00 0x00 0x00 0x00 0x00 0x01 0x02 0x00 0x00 0x28 0x95f 0x00 0x00 0x01 0x03 0x40f 0x00 0x437 0x95f 0x00 0x00>;
		synaptics,panel-display-resolution = <0x5a0 0xc80>;
		syna,qts_en;
		syna,touch-type = "primary";
		qts,trusted-touch-mode = "vm_mode";
		qts,touch-environment = "tvm";
		qts,trusted-touch-type = "primary";
		qts,trusted-touch-spi-irq = <0x28c>;
		qts,trusted-touch-io-bases = <0xa88000>;
		qts,trusted-touch-io-sizes = <0x1000>;
		qts,trusted-touch-vm-gpio-list = <&tlmm 0x28 0x00 &tlmm 0x29 0x00 &tlmm 0x2a 0x00 &tlmm 0x2b 0x00 &tlmm 0xa1 0x00 &tlmm 0xa2 0x2008>;
		synaptics,config-array-size = <0x02>;
		synaptics,default-thp-config-name = "dada_syna_thp_config_00.ini";
		synaptics,default-fw-image-name = "synaptics_spi_dada_00.img";
		synaptics,default-test-limit-name = "dada_test_limits_S3910P_00.csv";

		synpatics,cfg_0 {
			synaptics,tp-vendor = <0x01>;
			synaptics,dp-vendor = <0x42>;
			synaptics,thp-config-name = "dada_syna_thp_config_00.ini";
			synaptics,fw-image-name = "synaptics_spi_dada_00.img";
			synaptics,test-limit-name = "dada_test_limits_S3910P_00.csv";
		};

		synpatics,cfg_1 {
			synaptics,tp-vendor = <0x00>;
			synaptics,dp-vendor = <0x45>;
			synaptics,thp-config-name = "dada_syna_thp_config_01.ini";
			synaptics,fw-image-name = "synaptics_spi_dada_01.img";
			synaptics,test-limit-name = "dada_test_limits_S3910P_01.csv";
		};
	};
};
