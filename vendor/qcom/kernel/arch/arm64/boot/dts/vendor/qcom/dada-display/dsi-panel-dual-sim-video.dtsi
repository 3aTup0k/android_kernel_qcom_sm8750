// SPDX-License-Identifier: BSD-3-Clause
/*
 * Copyright (c) 2023-2024 Qualcomm Innovation Center, Inc. All rights reserved.
 * Copyright (c) 2025 The LineageOS Project
 */

dsi_dual_sim_vid: qcom,mdss_dsi_dual_sim_video {
	qcom,mdss-dsi-qsync-min-refresh-rate = <0x2d>;
	qcom,qsync-enable;
	qcom,panel-ack-disabled;
	qcom,mdss-dsi-reset-sequence = <0x01 0x14 0x00 0xc8 0x01 0x14>;
	qcom,mdss-dsi-mdp-trigger = "none";
	qcom,mdss-dsi-dma-trigger = "trigger_sw";
	qcom,mdss-dsi-bl-max-level = <0xfff>;
	qcom,mdss-dsi-lane-3-state;
	qcom,mdss-dsi-lane-2-state;
	qcom,mdss-dsi-lane-1-state;
	qcom,mdss-dsi-lane-0-state;
	qcom,mdss-dsi-panel-broadcast-mode;
	qcom,mdss-dsi-bllp-power-mode;
	qcom,mdss-dsi-bllp-eof-power-mode;
	qcom,mdss-dsi-traffic-mode = "non_burst_sync_event";
	qcom,mdss-dsi-border-color = <0x00>;
	qcom,mdss-dsi-underflow-color = <0xff>;
	qcom,mdss-dsi-bpp = <0x18>;
	qcom,mdss-dsi-stream = <0x00>;
	qcom,mdss-dsi-virtual-channel-id = <0x00>;
	qcom,dsi-phy-num = <0x00 0x01>;
	qcom,dsi-ctrl-num = <0x00 0x01>;
	qcom,mdss-dsi-panel-type = "dsi_video_mode";
	qcom,mdss-dsi-panel-name = "Sim dual video mode dsi panel";

	qcom,mdss-dsi-display-timings {

		timing@0 {
			qcom,mdss-dsi-qsync-off-commands-state = "dsi_hs_mode";
			qcom,mdss-dsi-qsync-off-commands = [15 01 00 00 00 00 02 51 00];
			qcom,mdss-dsi-qsync-on-commands-state = "dsi_hs_mode";
			qcom,mdss-dsi-qsync-on-commands = [15 01 00 00 00 00 02 51 00];
			qcom,mdss-dsi-off-command-state = "dsi_hs_mode";
			qcom,mdss-dsi-off-command = [05 01 00 00 32 00 02 28 00 05 01 00 00 78 00 02 10 00];
			qcom,mdss-dsi-on-command-state = "dsi_lp_mode";
			qcom,mdss-dsi-panel-framerate = <0x3c>;
			qcom,mdss-dsi-h-sync-pulse = <0x00>;
			qcom,mdss-dsi-v-bottom-border = <0x00>;
			qcom,mdss-dsi-v-top-border = <0x00>;
			qcom,mdss-dsi-h-right-border = <0x00>;
			qcom,mdss-dsi-h-left-border = <0x00>;
			qcom,mdss-dsi-v-pulse-width = <0x04>;
			qcom,mdss-dsi-v-front-porch = <0x08>;
			qcom,mdss-dsi-v-back-porch = <0x04>;
			qcom,mdss-dsi-h-sync-skew = <0x00>;
			qcom,mdss-dsi-h-pulse-width = <0x10>;
			qcom,mdss-dsi-h-back-porch = <0x2c>;
			qcom,mdss-dsi-h-front-porch = <0x78>;
			qcom,mdss-dsi-panel-height = <0x5a0>;
			qcom,mdss-dsi-panel-width = <0x500>;
			cell-index = <0x00>;
		};
	};
};
