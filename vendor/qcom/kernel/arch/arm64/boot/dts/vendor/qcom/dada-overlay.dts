// SPDX-License-Identifier: BSD-3-Clause
/*
 * Copyright (c) 2023-2024 Qualcomm Innovation Center, Inc. All rights reserved.
 * Copyright (c) 2025 The LineageOS Project
 */

/dts-v1/;
/plugin/;

#include "dada.dtsi"

/ {
	model = "Qualcomm Technologies, Inc. Haotian based on SM8750";
	compatible = "qcom,sun-mtp", "qcom,sun", "qcom,sunp-mtp", "qcom,sunp", "qcom,mtp";
	qcom,msm-id = <0x100026a 0x20000 0x27f 0x10000 0x26a 0x10000 0x27f 0x20000 0x26a 0x20000 0x100027f 0x10000 0x100026a 0x10000 0x100027f 0x20000>;
	qcom,board-id = <0x40008 0x00>;
	xiaomi,miboard-id = <0x02 0x00>;
};
